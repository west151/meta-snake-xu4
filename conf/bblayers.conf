## conf/bblayers.conf
```bitbake
# POKY_BBLAYERS_CONF_VERSION is increased each time build/conf/bblayers.conf
# changes incompatibly
POKY_BBLAYERS_CONF_VERSION = "2"

BBPATH = "${TOPDIR}"
BBFILES ?= ""

BBLAYERS ?= " \
  /home/rocko/yocto-data/odroid/poky-sumo/meta \
  /home/rocko/yocto-data/odroid/poky-sumo/meta-poky \
  /home/rocko/yocto-data/odroid/poky-sumo/meta-yocto-bsp \
  /home/rocko/yocto-data/odroid/poky-sumo/meta-openembedded/meta-oe \
  /home/rocko/yocto-data/odroid/poky-sumo/meta-openembedded/meta-networking \
  /home/rocko/yocto-data/odroid/poky-sumo/meta-openembedded/meta-python \
  /home/rocko/yocto-data/odroid/poky-sumo/meta-odroid \
  /home/rocko/yocto-data/odroid/poky-sumo/meta-qt5 \
  /home/rocko/yocto-data/odroid/poky-sumo/meta-snake-xu4 \
  "
```

## conf/layer.conf
```bitbake
# We have a conf and classes directory, append to BBPATH
BBPATH .= ":${LAYERDIR}"

BBFILES += "${LAYERDIR}/recipes*/*/*.bb ${LAYERDIR}/recipes*/*/*.bbappend ${LAYERDIR}/images/*.bb"

BBFILE_COLLECTIONS += "meta-snake-xu4"
BBFILE_PATTERN_meta-snake-xu4 := "^${LAYERDIR}/"
BBFILE_PRIORITY_meta-snake-xu4 = "16"

LAYERSERIES_COMPAT_meta-snake-xu4 = "sumo thud"
```
